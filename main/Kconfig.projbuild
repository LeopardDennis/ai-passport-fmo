## main/Kconfig.projbuild
```kconfig
menu "FMO Live Monitor"

config FMO_WIFI_SSID
    string "Wi-Fi SSID"
    default ""
    help
        The 2.4 GHz Wi-Fi network used by AI Passport. Keep the tracked default
        empty and configure the real value in the untracked sdkconfig file.

config FMO_WIFI_PASSWORD
    string "Wi-Fi password"
    default ""
    help
        Password for the selected Wi-Fi network. Open networks may leave this
        empty. Never commit a populated sdkconfig file.

config FMO_HOST
    string "FMO host name or IPv4 address"
    default "fmo.local"
    help
        LAN address of the FMO device, without ws://, a port, or a path. An IPv4
        address is recommended when the local network does not resolve .local.

config FMO_PORT
    int "FMO web interface port"
    range 1 65535
    default 80

config FMO_BACKLIGHT
    int "Initial display brightness percent"
    range 20 100
    default 80

config FMO_VOLUME
    int "Initial conversation volume percent"
    range 0 100
    default 50
    help
        Auto-play received FMO PCM audio after connection. UP/DOWN changes volume
        by 10 percent; short OK toggles audio. Long OK opens stations; long UP opens network settings.
        Volume 0 silences audio. These runtime settings reset on reboot.

config FMO_GEOCODER_URL
    string "Photon reverse-geocoding HTTPS endpoint (empty disables lookup)"
    default "https://photon.komoot.io/reverse"
    help
        Sends only WGS84 coordinates, never callsigns or credentials. Uses a
        bounded persistent cache and at most one request every 15 seconds.
        The public demo has no availability guarantee. For a large deployment,
        configure your own Photon endpoint. OpenStreetMap attribution applies.

endmenu
```
